## meta-openbmc-mods/conf/layer.conf
```bitbake
# We have a conf and classes directory, add to BBPATH
BBPATH .= ":${LAYERDIR}"

# We have recipes-* directories, add to BBFILES
BBFILES += "${LAYERDIR}/recipes-*/*/*.bb \
        ${LAYERDIR}/recipes-*/*/*.bbappend"

BBFILE_COLLECTIONS += "intel-openbmc"
BBFILE_PATTERN_intel-openbmc = "^${LAYERDIR}/"
BBFILE_PRIORITY_intel-openbmc = "5"
LAYERSERIES_COMPAT_intel-openbmc = "dunfell gatesgarth"

IMAGE_FEATURES[validitems] += "tools-sdk tools-debug validation-unsecure"

# static userid assignments
USERADDEXTENSION = "useradd-staticids"
USERADD_UID_TABLES = "files/passwd"
USERADD_GID_TABLES = "files/group"

LAYER_CONF_VERSION = "14"

INTELBASE = '${@os.path.normpath("${LAYERDIR}/")}'
```

## meta-openbmc-mods/conf/machine/include/intel.inc
```bitbake
OBMC_MACHINE_FEATURES += "\
        obmc-phosphor-fan-mgmt \
        obmc-phosphor-chassis-mgmt \
        obmc-phosphor-flash-mgmt \
        obmc-host-ipmi \
        obmc-host-state-mgmt \
        obmc-chassis-state-mgmt \
        obmc-bmc-state-mgmt \
        "

VIRTUAL-RUNTIME_skeleton_workbook = "${MACHINE}-config"
VIRTUAL-RUNTIME_obmc-inventory-manager = "entity-manager"
VIRTUAL-RUNTIME_obmc-led-monitor = ""
VIRTUAL-RUNTIME_obmc-host-state-manager = "x86-power-control"
VIRTUAL-RUNTIME_obmc-chassis-state-manager = "x86-power-control"
VIRTUAL-RUNTIME_obmc-discover-system-state = "x86-power-control"

PREFERRED_PROVIDER_virtual/obmc-host-ipmi-hw = "phosphor-ipmi-kcs"
PREFERRED_PROVIDER_virtual/obmc-chassis-mgmt = "packagegroup-intel-apps"
PREFERRED_PROVIDER_virtual/obmc-fan-mgmt = "packagegroup-intel-apps"
PREFERRED_PROVIDER_virtual/obmc-flash-mgmt = "packagegroup-intel-apps"
PREFERRED_PROVIDER_virtual/obmc-system-mgmt = "packagegroup-intel-apps"
PREFERRED_PROVIDER_virtual/obmc-host-ctl ?= ""
PREFERRED_PROVIDER_virtual/obmc-inventory-data = "entity-manager"
PREFERRED_PROVIDER_virtual/phosphor-led-manager-config-native ?= "intel-led-manager-config-native"
#PREFERRED_PROVIDER_virtual/obmc-gpio-monitor ?= "phosphor-gpio-monitor"

# add all the upstream intel override fixes
OVERRIDES .= ":intel"
```

## meta-openbmc-mods/meta-ast2500-sam/conf/layer.conf
```bitbake
LOCALCONF_VERSION = "3"
# We have a conf and classes directory, add to BBPATH
BBPATH .= ":${LAYERDIR}"

# We have recipes-* directories, add to BBFILES
BBFILES += "${LAYERDIR}/recipes-*/*/*.bb \
            ${LAYERDIR}/recipes-*/*/*.bbappend"

BBFILE_COLLECTIONS += "ast2500-sam"
BBFILE_PATTERN_ast2500-sam = "^${LAYERDIR}/"
BBFILE_PRIORITY_ast2500-sam = "10"
LAYERSERIES_COMPAT_ast2500-sam = "gatesgarth hardknott honister"

INHERIT += "extrausers"
#INHERIT += " cve-check"

EXTRA_USERS_PARAMS:append:pn-intel-platforms = " \
${@bb.utils.contains('EXTRA_IMAGE_FEATURES', 'debug-tweaks', "usermod -p '\$1\$UGMqyqdG\$FZiylVFmRRfl9Z0Ue8G7e/' root;", '', d)}"

hostname:pn-base-files = "Sam BMC Firmware"
```

## meta-openbmc-mods/meta-ast2500/conf/machine/include/intel-ast2500.inc
```bitbake
KMACHINE = "aspeed"
KERNEL_DEVICETREE = " \
    ${KMACHINE}-bmc-intel-ast2500.dtb \
    ${KMACHINE}-bmc-intel-s2600wf.dtb \
    "

require conf/machine/include/ast2500.inc
require conf/machine/include/obmc-bsp-si-common.inc
require conf/machine/include/intel.inc
require conf/distro/include/phosphor-isolation.inc

UBOOT_MACHINE = "ast_g5_phy_config"

VIRTUAL-RUNTIME_skeleton_workbook = "${MACHINE}-config"
```

## meta-openbmc-mods/meta-ast2600/conf/layer.conf
```bitbake
LOCALCONF_VERSION = "3"
# We have a conf and classes directory, add to BBPATH
BBPATH .= ":${LAYERDIR}"

# We have recipes-* directories, add to BBFILES
BBFILES += "${LAYERDIR}/recipes-*/*/*.bb \
            ${LAYERDIR}/recipes-*/*/*.bbappend"

BBFILE_COLLECTIONS += "ast2600"
BBFILE_PATTERN_ast2600 = "^${LAYERDIR}/"
BBFILE_PRIORITY_ast2600 = "10"
LAYERSERIES_COMPAT_ast2600 = "dunfell gatesgarth"

INHERIT += "extrausers"
#INHERIT += " cve-check"

EXTRA_USERS_PARAMS_append_pn-intel-platforms = " \
${@bb.utils.contains('EXTRA_IMAGE_FEATURES', 'debug-tweaks', "usermod -p '\$1\$UGMqyqdG\$FZiylVFmRRfl9Z0Ue8G7e/' root;", '', d)}"

hostname_pn-base-files = "intel-obmc"
```

## meta-openbmc-mods/meta-ast2600/conf/machine/include/intel-ast2600.inc
```bitbake
COMPATIBLE_MACHINE_intel-ast2600 = "intel-ast2600"
KMACHINE = "aspeed"
KERNEL_DEVICETREE = " \
    ${KMACHINE}-bmc-${COMPATIBLE_MACHINE}.dtb \
    "
#KERNEL_DEVICETREE = "${KMACHINE}-ast2600-evb.dtb"

require conf/machine/include/ast2600.inc
require conf/machine/include/obmc-bsp-si-common.inc
require conf/machine/include/intel.inc

TARGET_FPU = "hard"

PREFERRED_PROVIDER_u-boot-fw-utils ?= "u-boot-fw-utils-aspeed-sdk"

UBOOT_MACHINE = "ast2600_openbmc_defconfig"
UBOOT_DEVICETREE = "ast2600-intel"

VIRTUAL-RUNTIME_skeleton_workbook = "${MACHINE}-config"

IMAGE_CLASSES += "${@bb.utils.contains('IMAGE_FSTYPES', 'intel-pfr', 'image_types_intel_pfr', '', d)}"
```

## meta-openbmc-mods/meta-ast2600/conf/machine/include/obmc-bsp-si-common.inc
```bitbake
#@TYPE: Machine
#@NAME: OpenBMC
#@DESCRIPTION: Common machine configuration for OpenBMC chips

MACHINE_EXTRA_RRECOMMENDS = " kernel-modules"
EXTRA_IMAGEDEPENDS += "u-boot"

IMAGE_FSTYPES += "squashfs-xz"
IMAGE_FSTYPES += "mtd-auto"
INITRAMFS_FSTYPES = "squashfs-xz"
EXTRA_IMAGECMD_squashfs-xz_append = "-processors ${BB_NUMBER_THREADS} -b 262144 -Xdict-size 100% -Xbcj arm"

KERNEL_CLASSES ?= "kernel-fitimage"
KERNEL_IMAGETYPES ?= "fitImage"
KERNEL_EXTRA_ARGS += "LOADADDR=${UBOOT_ENTRYPOINT}"

UBOOT_SUFFIX ?= "bin"

MACHINEOVERRIDES =. "openbmc:"

OBMC_PHOSPHOR_IMAGE_OVERLAY= "1"
OBMC_IMAGE_EXTRA_INSTALL_append = "u-boot-fw-utils-aspeed-sdk"

IMAGE_CLASSES += "image_types image_types_phosphor_auto qemuboot"

# do not generate an initramfs; use the above squashfs-xz as an initrd instead
INITRAMFS_FSTYPES = ""
INITRAMFS_CTYPE = ""
INITRAMFS_IMAGE = ""

MACHINE_FEATURES_BACKFILL_CONSIDERED = "qemu-usermode"

KERNEL_IMAGETYPES += "zImage"

# runqemu
QB_SYSTEM_NAME = "qemu-system-arm"
QB_DEFAULT_FSTYPE = "mtd"
QB_ROOTFS_OPT = "-drive file=@ROOTFS@,format=raw,if=mtd"
QB_MACHINE = "-M intel-ast2600"
QB_OPT_APPEND += " -nographic -serial mon:stdio -serial none"
QB_OPT_APPEND += " -global driver=aspeed.gpio-ast2600,property=gpioC0,value=true"
QB_NETWORK_DEVICE = "-net nic,macaddr=C0:FF:EE:00:00:02,model=ftgmac100"
QB_DEFAULT_KERNEL = "none"
QB_RNG = ""
QB_MEM = "1024"
```

## meta-openbmc-mods/meta-common-small/conf/layer.conf
```bitbake
# We have a conf and classes directory, add to BBPATH
BBPATH .= ":${LAYERDIR}"

# We have recipes-* directories, add to BBFILES
BBFILES += "${LAYERDIR}/recipes-*/*/*.bb \
    ${LAYERDIR}/recipes-*/*/*.bbappend"

BBFILE_COLLECTIONS += "common-small"
BBFILE_PATTERN_common-small = "^${LAYERDIR}/"
BBFILE_PRIORITY_common-small = "9"
LAYERSERIES_COMPAT_common-small = "dunfell gatesgarth"
```

## meta-openbmc-mods/meta-egs/conf/bblayers.conf.sample
```bitbake
# LAYER_CONF_VERSION is increased each time build/conf/bblayers.conf
# changes incompatibly
LCONF_VERSION = "10"

BBPATH = "${TOPDIR}"
BBFILES ?= ""

BBLAYERS ?= " \
  ##OEROOT##/meta \
  ##OEROOT##/meta-poky \
  ##OEROOT##/meta-openembedded/meta-oe \
  ##OEROOT##/meta-openembedded/meta-networking \
  ##OEROOT##/meta-openembedded/meta-perl \
  ##OEROOT##/meta-openembedded/meta-python \
  ##OEROOT##/meta-phosphor \
  ##OEROOT##/meta-aspeed \
  ##OEROOT##/meta-x86 \
  ##OEROOT##/meta-openbmc-mods \
  ##OEROOT##/meta-intel \
  ##OEROOT##/meta-openbmc-mods/meta-common \
  ##OEROOT##/meta-openbmc-mods/meta-common-small \
  ##OEROOT##/meta-openbmc-mods/meta-ast2600 \
  ##OEROOT##/meta-openbmc-mods/meta-egs \
  ##OEROOT##/meta-security \
  "
```

## meta-openbmc-mods/meta-egs/conf/layer.conf
```bitbake
LOCALCONF_VERSION = "4"
# We have a conf and classes directory, add to BBPATH
BBPATH .= ":${LAYERDIR}"

# We have recipes-* directories, add to BBFILES
BBFILES += "${LAYERDIR}/recipes-*/*/*.bb \
            ${LAYERDIR}/recipes-*/*/*.bbappend"

BBFILE_COLLECTIONS += "egs"
BBFILE_PATTERN_egs = ""
BBFILE_PRIORITY_egs = "7"
LAYERSERIES_COMPAT_egs = "warrior zeus"

PRODUCT_GENERATION = "egs"
```

## meta-openbmc-mods/meta-wht-sam/conf/local.conf.sample
```bitbake
MACHINE ??= "intel-ast2500-sam"
#DL_DIR ?= "/~YoctoDownloads"
#SSTATE_DIR ?= "/~YoctoSstate-cache"
DISTRO ?= "openbmc-phosphor"
PACKAGE_CLASSES ?= "package_rpm"
SANITY_TESTED_DISTROS:append ?= " RedHatEnterpriseWorkstation-6.*"
EXTRA_IMAGE_FEATURES = "validation-unsecure"
# Uncomment the following line to enable debug features / default user account.
EXTRA_IMAGE_FEATURES += "debug-tweaks"
USER_CLASSES ?= "buildstats"
PATCHRESOLVE = "noop"

# PFR image Build
# Before exporting the conf, please uncomment the below line
# for building Intel PFR compliant images.
#IMAGE_FSTYPES += "intel-pfr"

BB_DISKMON_DIRS ??= "\
    STOPTASKS,${TMPDIR},1G,100K \
    STOPTASKS,${DL_DIR},1G,100K \
    STOPTASKS,${SSTATE_DIR},1G,100K \
    STOPTASKS,/tmp,100M,100K \
    ABORT,${TMPDIR},100M,1K \
    ABORT,${DL_DIR},100M,1K \
    ABORT,${SSTATE_DIR},100M,1K \
    ABORT,/tmp,10M,1K"
CONF_VERSION = "5"
#BB_NUMBER_THREADS = "70"

FULL_OPTIMIZATION = "-Os -pipe ${DEBUG_FLAGS}"

# The following class prints the SRC_URI of each recipe in the build
# Once enabled, run 'bitbake intel-platforms --runonly print_src'
# on a clean workspace to get the output
#INHERIT += "print-src"
```

## meta-openbmc-mods/meta-wht/conf/bblayers.conf.sample
```bitbake
# LAYER_CONF_VERSION is increased each time build/conf/bblayers.conf
# changes incompatibly
LCONF_VERSION = "14"

BBPATH = "${TOPDIR}"
BBFILES ?= ""

# meta-intel-openbmc has a config file that needs to be overridden
BBMASK = "/meta-intel-openbmc/meta-common/recipes-phosphor/ipmi/phosphor-ipmi-ipmb"

BBLAYERS ?= " \
  ##OEROOT##/meta \
  ##OEROOT##/meta-poky \
  ##OEROOT##/meta-openembedded/meta-oe \
  ##OEROOT##/meta-openembedded/meta-networking \
  ##OEROOT##/meta-openembedded/meta-perl \
  ##OEROOT##/meta-openembedded/meta-python \
  ##OEROOT##/meta-phosphor \
  ##OEROOT##/meta-aspeed \
  ##OEROOT##/meta-x86 \
  ##OEROOT##/meta-openbmc-mods \
  ##OEROOT##/meta-intel-openbmc \
  ##OEROOT##/meta-openbmc-mods/meta-common \
  ##OEROOT##/meta-openbmc-mods/meta-common-small \
  ##OEROOT##/meta-openbmc-mods/meta-ast2500 \
  ##OEROOT##/meta-openbmc-mods/meta-wht \
  ##OEROOT##/meta-security \
  "
```

## meta-openbmc-mods/meta-wht/conf/layer.conf
```bitbake
LOCALCONF_VERSION = "5"
# We have a conf and classes directory, add to BBPATH
BBPATH .= ":${LAYERDIR}"

# We have recipes-* directories, add to BBFILES
BBFILES += "${LAYERDIR}/recipes-*/*/*.bb \
            ${LAYERDIR}/recipes-*/*/*.bbappend"

BBFILE_COLLECTIONS += "wht"
BBFILE_PATTERN_wht = "^${LAYERDIR}/"
BBFILE_PRIORITY_wht = "11"
LAYERSERIES_COMPAT_wht = "dunfell gatesgarth"

PRODUCT_GENERATION = "wht"
```

## meta-openbmc-mods/meta-wolfpass/conf/bblayers.conf.sample
```bitbake
# LAYER_CONF_VERSION is increased each time build/conf/bblayers.conf
# changes incompatibly
LCONF_VERSION = "14"

BBPATH = "${TOPDIR}"
BBFILES ?= ""

BBLAYERS ?= " \
  ##OEROOT##/meta \
  ##OEROOT##/meta-poky \
  ##OEROOT##/meta-openembedded/meta-oe \
  ##OEROOT##/meta-openembedded/meta-networking \
  ##OEROOT##/meta-openembedded/meta-perl \
  ##OEROOT##/meta-openembedded/meta-python \
  ##OEROOT##/meta-phosphor \
  ##OEROOT##/meta-aspeed \
  ##OEROOT##/meta-x86 \
  ##OEROOT##/meta-openbmc-mods \
  ##OEROOT##/meta-intel-openbmc \
  ##OEROOT##/meta-openbmc-mods/meta-common \
  ##OEROOT##/meta-openbmc-mods/meta-common-small \
  ##OEROOT##/meta-openbmc-mods/meta-ast2500 \
  ##OEROOT##/meta-openbmc-mods/meta-wolfpass \
  ##OEROOT##/meta-security \
  "
```

## meta-openbmc-mods/meta-wolfpass/conf/layer.conf
```bitbake
LOCALCONF_VERSION = "4"
# We have a conf and classes directory, add to BBPATH
BBPATH .= ":${LAYERDIR}"

# We have recipes-* directories, add to BBFILES
BBFILES += "${LAYERDIR}/recipes-*/*/*.bb \
            ${LAYERDIR}/recipes-*/*/*.bbappend"

BBFILE_COLLECTIONS += "wolfpass"
BBFILE_PATTERN_wolfpass = "^${LAYERDIR}/"
BBFILE_PRIORITY_wolfpass = "11"
LAYERSERIES_COMPAT_wolfpass = "dunfell gatesgarth"

PRODUCT_GENERATION = "prl"
```

## meta-openbmc-mods/meta-wolfpass/conf/local.conf.sample
```bitbake
MACHINE ??= "intel-ast2500"
#DL_DIR ?= "/~YoctoDownloads"
#SSTATE_DIR ?= "/~YoctoSstate-cache"
DISTRO ?= "openbmc-phosphor"
PACKAGE_CLASSES ?= "package_rpm"
SANITY_TESTED_DISTROS_append ?= " RedHatEnterpriseWorkstation-6.*"
EXTRA_IMAGE_FEATURES = "validation-unsecure"
# Uncomment the following line to enable debug features / default user account.
#EXTRA_IMAGE_FEATURES += "debug-tweaks"
USER_CLASSES ?= "buildstats image-mklibs image-prelink"
PATCHRESOLVE = "noop"
BB_DISKMON_DIRS = "\
    STOPTASKS,${TMPDIR},1G,100K \
    STOPTASKS,${DL_DIR},1G,100K \
    STOPTASKS,${SSTATE_DIR},1G,100K \
    STOPTASKS,/tmp,100M,100K \
    ABORT,${TMPDIR},100M,1K \
    ABORT,${DL_DIR},100M,1K \
    ABORT,${SSTATE_DIR},100M,1K \
    ABORT,/tmp,10M,1K"
CONF_VERSION = "4"
#BB_NUMBER_THREADS = "70"

FULL_OPTIMIZATION = "-Os -pipe ${DEBUG_FLAGS}"
require conf/distro/include/security_flags.inc
```

## meta-openbmc-mods/meta-wolfpass/conf/machine/wolfpass.conf
```bitbake
KMACHINE = "aspeed"
KERNEL_DEVICETREE = "${KMACHINE}-bmc-intel-purley.dtb"

require conf/machine/include/ast2500.inc
require conf/machine/include/obmc-bsp-si-common.inc
require conf/machine/include/intel.inc
require conf/distro/include/phosphor-tiny.inc

UBOOT_MACHINE = "ast_g5_phy_config"

#Developer to specify the appropriate IMAGE_TYPE and FLASH_SIZE
#On Intel Whitley platforms PFR feature requires 128MB flash, default is 64MB
#IMAGE_TYPE = "default" or "pfr" or "non-pfr"
# "non-pfr" setting for future which is for BMC secure boot
#for PFR its 128MB in KBs - 128*1024=131072, for non-pfr its 64MB= 64*1024 = 65536
#pfr IMAGE_TYPE enforces the image signature verification during the image update
IMAGE_TYPE = "default"

VIRTUAL-RUNTIME_skeleton_workbook = "${MACHINE}-config"
```
